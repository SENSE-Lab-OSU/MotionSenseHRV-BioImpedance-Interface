&spi1 {
	compatible = "nordic,nrf-spim";
	status = "okay";
	mosi-pin = <21>;
	miso-pin = <22>;	
	sck-pin = <20>;
	cs-gpios = <&gpio0 23 0>;
};
&i2c1 {
	status = "disabled";
	compatible = "nordic,nrf-twim";
};
&i2c0 {
	status = "okay";
	compatible = "nordic,nrf-twim";
	sda-pin = < 34 >;
	scl-pin = < 35 >;
};

&spi4 {
	compatible = "nordic,nrf-spim";
	status = "okay";
	mosi-pin = <44>;
	miso-pin = <45>;	
	sck-pin = <46>;
	cs-gpios = <&gpio1 15 0>;
};


