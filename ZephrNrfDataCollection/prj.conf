## CMakeLists.txt
```
# SPDX-License-Identifier: Apache-2.0

# This is a general purpose project created from MotionSenseHRV to be used for data collection.

# Ohio State SENSE LAB

cmake_minimum_required(VERSION 3.13.1)
find_package(Zephyr REQUIRED HINTS $ENV{ZEPHYR_BASE})
project(external_lib)


# this is a defined k-config
# add_subdirectory_ifdef(CONFIG_CMSIS_DSP        src/DSP)
target_sources(app PRIVATE src/main.cc)
target_sources(app PRIVATE src/ppgSensor.cc)
target_sources(app PRIVATE src/batteryMonitor.cc)
target_sources(app PRIVATE src/imuSensor.cc)
target_sources(app PRIVATE src/orientation.cc)
include_directories(src/DSP/PrivateInclude)
target_sources(app PRIVATE src/constants.cc)
target_sources(app PRIVATE src/output_handler.cc)
target_sources(app PRIVATE src/assert.cc)

target_sources(app PRIVATE src/BLEService.cc)

# Other external build systems may be self-contained enough that they
# do not need any build information from zephyr. Or they may be
# incompatible with certain zephyr options and need them to be
# filtered out.

# set(TARGET ${BOARD})
# set(TARGET_ARCH cortex-m33)




set(extra_project_flags "-mcpu=${TARGET_ARCH} -mthumb -mno-thumb-interwork -mhard-float -mfpu=fpv5-sp-d16") #I had to remove -DTF_LITE_STATIC_MEMORY to make hello_world run. 

zephyr_get_include_directories_for_lang_as_string(       C C_includes)
zephyr_get_system_include_directories_for_lang_as_string(C C_system_includes)
zephyr_get_compile_definitions_for_lang_as_string(       C C_definitions)
zephyr_get_compile_options_for_lang_as_string(           C C_options)

set(external_project_cflags
  "${C_includes} ${C_definitions} ${optC_optionsions} ${C_system_includes} ${extra_project_flags}"
)

zephyr_get_include_directories_for_lang_as_string(       CXX CXX_includes)
zephyr_get_system_include_directories_for_lang_as_string(CXX CXX_system_includes)
zephyr_get_compile_definitions_for_lang_as_string(       CXX CXX_definitions)
zephyr_get_compile_options_for_lang_as_string(           CXX CXX_options)
```

## prj.conf
```kconfig
CONFIG_NCS_SAMPLES_DEFAULTS=y

CONFIG_STDOUT_CONSOLE=y
CONFIG_CPLUSPLUS=y
CONFIG_STD_CPP11=y
CONFIG_NEWLIB_LIBC=y
CONFIG_LIB_CPLUSPLUS=y
#CONFIG_DEBUG_OPTIMIZATIONS=y
CONFIG_SIZE_OPTIMIZATIONS=y


#Gpio Config
CONFIG_GPIO=y


# SPI Config
CONFIG_SPI=y
CONFIG_SPI_1=y
CONFIG_SPI_0=n
CONFIG_SPI_2=n
CONFIG_SPI_3=n
CONFIG_SPI_4=y

#I2C config
CONFIG_I2C=y
CONFIG_I2C_0=y

#Log config
CONFIG_RAM_CONSOLE=y
CONFIG_SERIAL=n
CONFIG_USE_SEGGER_RTT=y
CONFIG_LOG_BACKEND_RTT=y
CONFIG_RTT_CONSOLE=y
CONFIG_UART_CONSOLE=n
CONFIG_LOG_PRINTK=y

# CMSIS config
CONFIG_CMSIS_DSP=y
CONFIG_CMSIS_DSP_BASICMATH=y
CONFIG_CMSIS_DSP_COMPLEXMATH=n
CONFIG_CMSIS_DSP_CONTROLLER=n
CONFIG_CMSIS_DSP_DISTANCE=n
CONFIG_CMSIS_DSP_FASTMATH=y
CONFIG_CMSIS_DSP_FILTERING=y
CONFIG_CMSIS_DSP_MATRIX=y
CONFIG_CMSIS_DSP_STATISTICS=y
CONFIG_CMSIS_DSP_TRANSFORM=n
CONFIG_CMSIS_DSP_SUPPORT=y

# timer config
CONFIG_NRFX_TIMER=y
CONFIG_NRFX_TIMER1=y


#FPU config
CONFIG_FPU=y
CONFIG_FP_HARDABI=y
CONFIG_NEWLIB_LIBC_FLOAT_PRINTF=y

#CONFIG_BT_CTLR_TX_BUFFER_SIZE=251
#CONFIG_BT_CTLR_DATA_LENGTH_MAX=251
#CONFIG_BT_RX_BUF_LEN=255

# Library for buttons and LEDs
CONFIG_DK_LIBRARY=y

# Enable bluetooth and bonding
CONFIG_BT_SETTINGS=y
CONFIG_BT=y
#CONFIG_BT_BONDABLE=y
#CONFIG_BT_BONDING_REQUIRED=y
CONFIG_BT_DEBUG_LOG=y
CONFIG_BT_DEVICE_APPEARANCE=833
CONFIG_BT_GAP_PERIPHERAL_PREF_PARAMS=y
CONFIG_BT_MAX_CONN=1
CONFIG_BT_L2CAP_TX_BUF_COUNT=	6
CONFIG_BT_L2CAP_RX_MTU=253
CONFIG_BT_L2CAP_TX_MTU=253

CONFIG_BT_PERIPHERAL=y
CONFIG_BT_PERIPHERAL_PREF_MAX_INT=10
CONFIG_BT_PERIPHERAL_PREF_MIN_INT=6
CONFIG_BT_PERIPHERAL_PREF_TIMEOUT=100
CONFIG_BT_DEVICE_NAME="MotionSenseF2"
CONFIG_BT_CTLR_CONN_PARAM_REQ=y
CONFIG_BT_SMP=y

# ENABLE device information service
CONFIG_BT_DIS=y
CONFIG_BT_DIS_FW_REV=y
CONFIG_BT_DIS_FW_REV_STR="1.0"
CONFIG_BT_DIS_HW_REV=y
CONFIG_BT_DIS_HW_REV_STR="1.0"
CONFIG_BT_DIS_MANUF="EETech"
CONFIG_BT_DIS_PNP=n
CONFIG_BT_DIS_MODEL="TensorFlowEn"
CONFIG_BT_DIS_SETTINGS=y
CONFIG_BT_MAX_PAIRED=1

# Enable Battery settings
CONFIG_BT_BAS=y

# SOftdevice configuration
CONFIG_BT_LL_SOFTDEVICE_DEFAULT=y



#DFU/FOTA settings

CONFIG_MCUMGR=y

CONFIG_STATS=y
CONFIG_STATS_NAMES=y

CONFIG_THREAD_MONITOR=y

CONFIG_BOOTLOADER_MCUBOOT=y
CONFIG_MCUBOOT_GENERATE_CONFIRMED_IMAGE=y
CONFIG_MCUMGR_CMD_OS_MGMT=y
CONFIG_MCUMGR_CMD_STAT_MGMT=y
CONFIG_MCUMGR_CMD_IMG_MGMT=y
CONFIG_MCUMGR_CMD_FS_MGMT=y
CONFIG_MCUMGR_SMP_BT=y


CONFIG_MCUMGR_LOG_LEVEL_DBG=n

CONFIG_MCUMGR_SMP_BT_AUTHEN=n



CONFIG_SETTINGS_RUNTIME=y
CONFIG_SETTINGS=y
CONFIG_SETTINGS_NONE=y
CONFIG_FLASH=y
CONFIG_FLASH_PAGE_LAYOUT=y
CONFIG_FLASH_MAP=y
CONFIG_NVS=y


CONFIG_SYSTEM_WORKQUEUE_STACK_SIZE=8192
CONFIG_HEAP_MEM_POOL_SIZE=16384
CONFIG_MAIN_STACK_SIZE=8192

# SOftdevice configuration
CONFIG_BT_LL_SOFTDEVICE_DEFAULT=y

# flash config
CONFIG_FLASH=y
CONFIG_FLASH_MAP=y
CONFIG_FLASH_PAGE_LAYOUT=y
CONFIG_FILE_SYSTEM=y
CONFIG_FILE_SYSTEM_LITTLEFS=y
CONFIG_MPU_ALLOW_FLASH_WRITE=y
```

## src/main.cc
```c
/*
 * Copyright (c) 2016 Intel Corporation
 *
 * SPDX-License-Identifier: Apache-2.0
 */

#include <zephyr.h>
#include <device.h>
#include <devicetree.h>
#include <drivers/gpio.h>
#include <drivers/spi.h>
#include <drivers/i2c.h>
#include <drivers/sensor.h>
#include <nrfx_timer.h>
#include <nrfx.h>
#include <nrfx_uarte.h>

#include "batteryMonitor.h"
#include "ppgSensor.h"
#include "imuSensor.h"
#include "common.h"
#include "BLEService.h"
#include <bluetooth/bluetooth.h>
#include <bluetooth/hci.h>
#include <bluetooth/conn.h>
#include <bluetooth/uuid.h>
#include <bluetooth/gatt.h>
#include <settings/settings.h>


//dfu configuration
#define INCLUDE_DFU

#ifdef INCLUDE_DFU
#ifdef CONFIG_BOOTLOADER_MCUBOOT
#include "os_mgmt/os_mgmt.h"
#include "img_mgmt/img_mgmt.h"
#include "stats/stats.h"
#include "stat_mgmt/stat_mgmt.h"

#include <mgmt/mcumgr/smp_bt.h>
#endif
#endif




/* 1000 msec = 1 sec */
#define SLEEP_TIME_MS   1000
uint8_t gyro_first_read = 0;
uint8_t magneto_first_read = 0;  
uint8_t ppgRead = 0;
bool ppgTFPass = false;
/* The devicetree node identifier for the "led0" alias. */
#define LED0_NODE DT_ALIAS(led0)
#define READMASTER 0x80
#if DT_NODE_HAS_STATUS(LED0_NODE, okay)
#define LED0	DT_GPIO_LABEL(LED0_NODE, gpios)
#define PIN	DT_GPIO_PIN(LED0_NODE, gpios)
#define FLAGS	DT_GPIO_FLAGS(LED0_NODE, gpios)
#else
/* A build error here means your board isn't set up to blink an LED. */
#error "Unsupported board: led0 devicetree alias is not defined"
#define LED0	""
#define PIN	0
#define FLAGS	0
#endif


#define WORKQUEUE_STACK_SIZE 1024

const struct device *gpioHandle_CS_IMU;
const struct device *gpioHandle_CS_ppg;

struct spi_cs_control imu_cs = {
.delay = 0, 
.gpio_pin = 23 , 
.gpio_dt_flags=GPIO_ACTIVE_LOW,
};
struct spi_cs_control ppg_cs = {
.delay = 0, 
.gpio_pin = 15 , 
.gpio_dt_flags=GPIO_ACTIVE_LOW,
};
/*
------------------------------------------------------------------------------------
SPI Mode    CPOL 	CPHA 	Clock Polarity  Clock Phase Used to 
                                in Idle State 	Sample and/or Shift the Data
------------------------------------------------------------------------------------
0               0         0 	Logic low 	Data sampled on rising edge and
                                                shifted out on the falling edge
1               0         1 	Logic low 	Data sampled on the falling edge and
                                                shifted out on the rising edge
2               1         1 	Logic high 	Data sampled on the falling edge and
                                                shifted out on the rising edge
3               1         0 	Logic high 	Data sampled on the rising edge and
                                                shifted out on the falling edge
-------------------------------------------------------------------------------------
*/
// SPI Mode-3 IMU
struct spi_config spi_cfg_imu = {
        .frequency = 1000000,
	.operation = SPI_WORD_SET(8) | SPI_TRANSFER_MSB |
		     SPI_MODE_CPOL | SPI_MODE_CPHA,
	.slave = 0,
	.cs=&imu_cs,
};
// SPI Mode-3 PPG
struct spi_config spi_cfg_ppg = {
        .frequency = 4000000,
	.operation = SPI_WORD_SET(8) | SPI_TRANSFER_MSB |
		     SPI_MODE_CPOL | SPI_MODE_CPHA,
	.slave = 0,
	.cs=&ppg_cs,
};

struct ppg_configData ppgConfig;
struct ppgData ppgData1;
static const nrfx_timer_t timer_global = NRFX_TIMER_INSTANCE(1); // Using TIMER1 as TIMER 0 is used by RTOS for blestruct device *spi_dev_imu;
const struct device *spi_dev_ppg,*spi_dev_imu;
const struct device *i2c_dev;
struct bq274xx_data batteryMonitor;
struct bq274xx_config batteryMonitorConfig;

struct ppgInfo my_ppgSensor;
uint8_t blePktTFMicro[ble_tfMicroPktLength];
struct batteryInfo my_battery ;  // work-queue instance for batter level

struct TfMicroInfo my_HeartRateEncoder;  // work-queue instance for tflite notifications
struct motionInfo my_motionSensor; // work-queue instance for motion sensor
struct magnetoInfo my_magnetoSensor; // work-queue instance for magnetometer
struct orientationInfo my_orientaionSensor; // work-queue instance for orientation
struct ppgDataInfo my_ppgDataSensor;

struct accData accData1;
struct gyroData gyroData1;
struct magnetoData magnetoData1;  
                   
struct accel_config accelConfig;
struct gyro_config gyroConfig;
struct magneto_config magnetoConfig;
struct orientation_config orientationConfig;

#define DEVICE_NAME             CONFIG_BT_DEVICE_NAME
#define DEVICE_NAME_LEN         (sizeof(DEVICE_NAME) - 1)

#define DIS_FW_REV_STR		 CONFIG_BT_DIS_FW_REV_STR
#define DIS_FW_REV_STR_LEN 	 (sizeof(DIS_FW_REV_STR))

#define DIS_HW_REV_STR 	 CONFIG_BT_DIS_HW_REV_STR
#define DIS_HW_REV_STR_LEN 	 (sizeof(DIS_HW_REV_STR))

#define DIS_MANUF		 CONFIG_BT_DIS_MANUF
#define DIS_MANUF_LEN 	 	 (sizeof(DIS_MANUF))

#define DIS_MODEL		 CONFIG_BT_DIS_MODEL
#define DIS_MODEL_LEN		 (sizeof(DIS_MODEL))

#define TIMER_MS 5
#define TIMER_PRIORITY 1
#define WORKQUEUE_PRIORITY 1

#define RUN_STATUS_LED          DK_LED1

K_THREAD_STACK_DEFINE(my_stack_area, WORKQUEUE_STACK_SIZE);


struct k_work_q my_work_q;

void timer_handler(nrf_timer_event_t, void*);

static K_SEM_DEFINE(ble_init_ok, 0, 1);

uint16_t global_counter;

static bool connectedFlag=false;
static const struct bt_data ad[] = {
  BT_DATA_BYTES(BT_DATA_FLAGS, (BT_LE_AD_GENERAL | BT_LE_AD_NO_BREDR)),
  BT_DATA(BT_DATA_NAME_COMPLETE, DEVICE_NAME, DEVICE_NAME_LEN),
};

static const struct bt_data sd[] = {
  BT_DATA_BYTES(BT_DATA_UUID128_ALL, TFMICRO_SERVICE_UUID),
};

struct bt_conn *my_connection;


// Setting up the device information service
static int settings_runtime_load(void){
  settings_runtime_set("bt/dis/model",
    DIS_MODEL,DIS_MODEL_LEN);
  settings_runtime_set("bt/dis/manuf",
    DIS_MANUF,DIS_MANUF_LEN);
  settings_runtime_set("bt/dis/fw",
    DIS_FW_REV_STR,DIS_FW_REV_STR_LEN);
  settings_runtime_set("bt/dis/hw",
    DIS_HW_REV_STR,DIS_HW_REV_STR_LEN);
  return 0;
}

static void timer_deinit(void){
  nrfx_timer_disable(&timer_global);
  nrfx_timer_uninit(&timer_global);	
  motion_sleep();
  ppg_sleep();
}

static void timer_init(void){
printk("timer init\n");
  uint32_t time_ticks;
  nrfx_err_t          err;
  nrfx_timer_config_t timer_cfg = {
          .frequency = NRF_TIMER_FREQ_1MHz,
          .mode      = NRF_TIMER_MODE_TIMER,
          .bit_width = NRF_TIMER_BIT_WIDTH_24,
          .interrupt_priority = TIMER_PRIORITY,
          .p_context = NULL,
  };  

  err = nrfx_timer_init(&timer_global, &timer_cfg, timer_handler);
  if (err != NRFX_SUCCESS) {
          printk("nrfx_timer_init failed with: %d\n", err);
  }
  else
          printk("nrfx_timer_init success with: %d\n", err);
  time_ticks = nrfx_timer_ms_to_ticks(&timer_global, TIMER_MS);
  printk("time ticks = %d\n", time_ticks);


  nrfx_timer_extended_compare(&timer_global, NRF_TIMER_CC_CHANNEL0, time_ticks \ 
   , NRF_TIMER_SHORT_COMPARE0_CLEAR_MASK, true);

  nrfx_timer_enable(&timer_global);
  printk("timer initialized\n");
}

static void connected(struct bt_conn *conn, uint8_t err){
  struct bt_conn_info info; 
  char addr[BT_ADDR_LE_STR_LEN];

  my_connection = conn;
  if (err) {
    printk("Connection failed (err %u)\n", err);
    return;
  }
  else if(bt_conn_get_info(conn, &info))
    printk("Could not parse connection info\n");
  else{  
  // Start the timer and stop advertising and initialize all the modules
    bt_addr_le_to_str(bt_conn_get_dst(conn), addr, sizeof(addr));
    printk("Connection established!		\n\
      Connected to: %s					\n\
      Role: %u							\n\
      Connection interval: %u				\n\
      Slave latency: %u					\n\
      Connection supervisory timeout: %u	\n"
      , addr, info.role, info.le.interval, info.le.latency, info.le.timeout);
		
    ppg_config();
    motion_config();
    
    connectedFlag=true;
    
    timer_init();
    global_counter = 0;
    gyro_first_read = 0;
    magneto_first_read = 0;  
    ppgRead = 0;
    ppgTFPass = false;
  }
}

static void disconnected(struct bt_conn *conn, uint8_t reason){
  // Stop timer and do all the cleanup
  printk("Disconnected (reason %u)\n", reason);
  timer_deinit();	
  connectedFlag=false;
}

static bool le_param_req(struct bt_conn *conn, struct bt_le_conn_param *param){
  //If acceptable params, return true, otherwise return false.
  if((param->interval_min > 9) && (param->interval_max > 20))
    return false;
  else
    return true; 
}

static void le_param_updated(struct bt_conn *conn, uint16_t interval, uint16_t latency, uint16_t timeout){
  struct bt_conn_info info; 
  char addr[BT_ADDR_LE_STR_LEN];
	
  if(bt_conn_get_info(conn, &info))
    printk("Could not parse connection info\n");
  else{
    bt_addr_le_to_str(bt_conn_get_dst(conn), addr, sizeof(addr));
    printk("Connection parameters updated!	\n\
      Connected to: %s						\n\
      New Connection Interval: %u				\n\
      New Slave Latency: %u					\n\
      New Connection Supervisory Timeout: %u	\n"
      , addr, info.le.interval, info.le.latency, info.le.timeout);
  }
}

static struct bt_conn_cb conn_callbacks = {
  .connected			= connected,
  .disconnected   		= disconnected,
  .le_param_req			= le_param_req,
  .le_param_updated		= le_param_updated
};


static void bt_ready(int err){
  if (err){
    printk("BLE init failed with error code %d\n", err);
    return;
  }
  else 	
    printk("BLE init success\n");
	
       
  settings_load();
	 
  settings_runtime_load();

  //Configure connection callbacks
  bt_conn_cb_register(&conn_callbacks);

  //Initalize services
  err = tfMicro_service_init();
        
  if (err)
    return;
	
  //Start advertising
  const struct bt_le_adv_param v={ \
    .id = BT_ID_DEFAULT, \
    .sid = 0, \
    .secondary_max_skip = 0, \
    .options = BT_LE_ADV_OPT_CONNECTABLE,\
    .interval_min = BT_GAP_ADV_FAST_INT_MIN_2, \
    .interval_max = BT_GAP_ADV_FAST_INT_MAX_2, \
    .peer = NULL
  };
	
  err = bt_le_adv_start(&v, ad, ARRAY_SIZE(ad),sd, ARRAY_SIZE(sd));
  if (err) 
    printk("Advertising failed to start (err %d)\n", err);
  else{
    printk("Advertising successfully started\n");
    }

  k_sem_give(&ble_init_ok);
}

// Initialize BLE
static void ble_init(void){
  int err;
  err = bt_enable(bt_ready);
  if (err){
    printk("BLE initialization failed\n");
  }
	
  
  if (!err)
    printk("Bluetooth initialized\n");
  else{
    printk("BLE initialization did not complete in time\n");
  }
  if (err) 
    printk("Bluetooth init failed (err %d)\n", err);	
}

// Timer handler that periodically executes commands with a period, 
// which is defined by the macro-variable TIMER_MS
static void spi_init(void){
  uint32_t dataFlash;
  const char* const spiName_imu = "SPI_1";
  const char* const spiName_ppg = "SPI_4";
 
  spi_dev_imu = device_get_binding(spiName_imu);
  gpioHandle_CS_IMU= device_get_binding("GPIO_0");
        
  spi_dev_ppg = device_get_binding(spiName_ppg);
  gpioHandle_CS_ppg= device_get_binding("GPIO_1");
               
  if (gpioHandle_CS_IMU == NULL) {
    printk("Could not get GPIO_0\n");
    return;
  }
	
  if (gpioHandle_CS_ppg == NULL) {
    printk("Could not get GPIO_1\n");
    return;
  }
	
  imu_cs.gpio_dev=gpioHandle_CS_IMU;
  if (spi_dev_imu == NULL) {
    printk("Could not get %s device\n", spiName_imu);
    return;
  }
  ppg_cs.gpio_dev=gpioHandle_CS_ppg;
  if (spi_dev_ppg == NULL) {
    printk("Could not get %s device\n", spiName_ppg);
    return;
  }
  ppgConfig.isEnabled = true;
  ppgConfig.sample_avg=0x08;
  ppgConfig.green_intensity = 0x28;
  ppgConfig.infraRed_intensity = 0x28;
  ppgConfig.sampling_time = 0x28;
  ppgConfig.numCounts = 8;
  ppgConfig.txPacketEnable = true;
  //high_pass_filter_init_25();

  fileOpen();
  dataFlash = (((uint32_t)ppgConfig.green_intensity)<<8) + ((uint32_t)ppgConfig.infraRed_intensity);
  printk("data combo = %d,%d,%d\n",dataFlash,((uint32_t)ppgConfig.green_intensity)<<8,(uint32_t)ppgConfig.infraRed_intensity );
  fileWrite(dataFlash);
  fileClose();


  accelConfig.isEnabled = true;
  accelConfig.txPacketEnable = true;
  accelConfig.sample_bw = ACCEL_DLPFCFG_12HZ;
  accelConfig.sensitivity = ACCEL_FS_SEL_4g;

  gyroConfig.isEnabled = true;
  gyroConfig.txPacketEnable = true;
  gyroConfig.tot_samples = 8;
  gyroConfig.sensitivity = GYRO_FS_SEL_250;
  orientationConfig.isEnabled = true;
  orientationConfig.txPacketEnable = true;
  magnetoConfig.isEnabled = true;
  magnetoConfig.txPacketEnable = true;
  tfMicroCoonfig.isEnabled = true;
  tfMicroCoonfig.txPacketEnable = true;

  configRead[1] = IMU_ENABLE | MAGNETOMETER_ENABLE | PPG_ENABLE | 
    ORIENTATION_ENABLE | TFMICRO_ENABLE;
  configRead[0] = MOTION_BLE_ENABLE | MAGNETOMETER_BLE_ENABLE | 
    PPG_BLE_ENABLE | ORIENTATION_BLE_ENABLE | TFMICRO_BLE_ENABLE;
  configRead[2] = ppgConfig.green_intensity;
  configRead[3] = ppgConfig.infraRed_intensity;
  configRead[4] = 0x12;
  configRead[5] = 0x44;
}
static void i2c_init(void){
  printk("The I2C Init started\n");
  i2c_dev = device_get_binding("I2C_0");
  if (!i2c_dev) {
    printk("Binding failed to i2c.");
    return;
  }
  i2c_configure(i2c_dev, I2C_SPEED_SET(I2C_SPEED_STANDARD));
   
  batteryMonitorConfig.design_capacity = 0x00AA; // 170 mAHour
  batteryMonitorConfig.taper_current = 0x0015; //21 mA
  batteryMonitorConfig.terminate_voltage = 0x0C1C; // 3100 mV
  bq274xx_gauge_init( &batteryMonitorConfig);
}


// Timer handler that periodically executes commands with a period, 
// which is defined by the macro-variable TIMER_MS

void timer_handler(nrf_timer_event_t event_type, void* p_context){
  if(connectedFlag == true){
    switch (event_type){
      case NRF_TIMER_EVENT_COMPARE0:

        // submit work to read gyro, acc, magnetometer and orientation
        my_motionSensor.magneto_first_read = magneto_first_read;
        my_motionSensor.pktCounter = global_counter;
        my_motionSensor.gyro_first_read = gyro_first_read;
        k_work_submit(&my_motionSensor.work);

        // Executes every 2 seconds to send battery level
        if(global_counter % 400 ==0) 
          k_work_submit(&my_battery.work);
    
        if(ppgRead  == 0){
          my_ppgSensor.pktCounter = global_counter;
          my_ppgSensor.movingFlag = gyroData1.movingFlag;
          my_ppgSensor.ppgTFPass = ppgTFPass;
          k_work_submit(&my_ppgSensor.work);
        }  
        // Executes every 8 seconds to send compressed signal
        
        ppgRead = (ppgRead+1) % ppgConfig.numCounts;
        magneto_first_read = (magneto_first_read +1) % (GYRO_SAMPLING_RATE/MAGNETO_SAMPLING_RATE);
        gyro_first_read = (gyro_first_read + 1) % (gyroConfig.tot_samples);
        break;

      default:
              //Do nothing.
        break;
    }
  }
}

void main(void){

  //this initializes FOTA
  #ifdef INCLUDE_DFU
  os_mgmt_register_group();
  
  img_mgmt_register_group();
  smp_bt_register();
  #endif


  const struct device *dev;
  bool led_is_on = true;
  int ret;

  IRQ_CONNECT(TIMER1_IRQn, TIMER_PRIORITY,
    nrfx_timer_1_irq_handler, NULL, 0);

  dev = device_get_binding(LED0);
  if (dev == NULL)
    return;
	
  ret = gpio_pin_configure(dev, PIN, GPIO_OUTPUT_ACTIVE | FLAGS);
  if (ret < 0)
    return;

  fs_mount_init();
  spi_init();
  uint8_t tx_buffer[4],rx_buffer[4];

  tx_buffer[0] = READMASTER | 0x00;
  tx_buffer[1] =0xFF;
  uint8_t txLen=2,rxLen=2;
  spiRead_registerIMU(tx_buffer, txLen, rx_buffer, rxLen);
  printk("Chip ID from motion sensor=%x\n",rx_buffer[1]);
	
  tx_buffer[0] = 0xFF;
  tx_buffer[1] = READMASTER;
  tx_buffer[2] = 0x00;
	
  txLen=3;
  rxLen=3;
  spiRead_registerPPG(tx_buffer, txLen, rx_buffer, rxLen);
  printk("Chip ID from ppg sensor=%x,%x,%x\n",rx_buffer[0],rx_buffer[1],rx_buffer[2]);
  
  ppg_config();
  motion_config();
  i2c_init(); 
  
  k_work_q_start(&my_work_q, my_stack_area,
    K_THREAD_STACK_SIZEOF(my_stack_area), WORKQUEUE_PRIORITY);
               
  k_work_init(&my_battery.work, bas_notify);     
  k_work_init(&my_motionSensor.work, motion_data_timeout_handler);
  k_work_init(&my_ppgSensor.work, read_ppg_fifo_buffer);
  k_work_init(&my_motionData.work, motion_notify);
  k_work_init(&my_magnetoSensor.work, magneto_notify);
  k_work_init(&my_orientaionSensor.work, orientation_notify);
  k_work_init(&my_ppgDataSensor.work, ppgData_notify);
  ble_init();
  


  while (1) {
    printk("%d\n", connectedFlag); 
    if(!connectedFlag)
      led_is_on = !led_is_on;
    else
      led_is_on = 0;
    gpio_pin_set(dev, PIN, (int)led_is_on);
    k_msleep(SLEEP_TIME_MS);
  }
}
```

## src/BLEService.cc
```c
#include <zephyr/types.h>
#include <stddef.h>
#include <string.h>
#include <errno.h>
#include <sys/printk.h>
#include <sys/byteorder.h>
#include <zephyr.h>
#include <soc.h>
#include "ppgSensor.h"
#include "imuSensor.h"
#include <bluetooth/bluetooth.h>
#include <bluetooth/hci.h>
#include <bluetooth/conn.h>
#include <bluetooth/uuid.h>
#include <bluetooth/addr.h>
#include <bluetooth/gatt.h>

#include "BLEService.h"
#define CONFIG_NAME "Configure sensor"
#define TFMICRO_NAME "Micromarker Heart-rate"
#define PPG_NAME "PPG Sensor"
#define ACC_NAME "Acc and Gyroscope"
#define MAGNETO_NAME "Magnetometer"
#define ORIENTATION_NAME "Orientation vector"

// Config Data Tx
// B_1 B_2 - 0x0001 PPG enabled
//         - 0x0002 IMU enabled
//         - 0x0004 orientation enabled
//         - 0x0008 TF micro enabled
//         - 0x0010 Magnetometer enabled
//         - 0x0100 PPG BLE transmit enable
//         - 0x0200 IMU BLE transmit enable
//         - 0x0400 orientation BLE transmit enable
//         - 0x0800 TF micro BLE transmit enable
//         - 0x1000 Magnetometer BLE transmit enable
// B_3     - Green intensity
// B_4     - Infra-red intensity
// B_5     - Gyro Sensitivity, Acc sensitivity
//         - 0x01 2g
//         - 0x02 4g
//         - 0x03 8g
//         - 0x04 16g
//         - 0x10 250 dps
//         - 0x20 500 dps
//         - 0x30 1000 dps
//         - 0x40 2000 dps
// B_6     - PPG sampling Rate, Motion Sampling rate
//         - 0x10 - PPG FS=200
//         - 0x20 - PPG FS=100
//         - 0x30 - PPG FS=50
//         - 0x40 - PPG FS=25
//         - 0x01 - Motion FS=200
//         - 0x02 - Motion FS=100
//         - 0x03 - Motion FS=50
//         - 0x04 - Motion FS=25
uint8_t configRead[6] = {0,0,0,0,0,0};
uint8_t ppgQuality[4] = {0};
uint8_t accQuality[4] = {0};
 struct bt_uuid_128 bt_uuid_tfmicro = BT_UUID_INIT_128(TFMICRO_SERVICE_UUID);
 struct bt_uuid_128 bt_uuid_config_rx = BT_UUID_INIT_128(RX_CHARACTERISTIC_UUID);
 struct bt_uuid_128 bt_uuid_tfmicro_tx = BT_UUID_INIT_128(TF_HR_TX_CHARACTERISTIC_UUID);
 struct bt_uuid_128 bt_uuid_ppg_tx = BT_UUID_INIT_128(PPG_TX_CHARACTERISTIC_UUID);
 struct bt_uuid_128 bt_uuid_acc_gyro_tx = BT_UUID_INIT_128(ACC_GRYO_TX_CHARACTERISTIC_UUID);
 struct bt_uuid_128 bt_uuid_magneto_tx = BT_UUID_INIT_128(MAGNETO_TX_CHARACTERISTIC_UUID);
 struct bt_uuid_128 bt_uuid_orientation_tx = BT_UUID_INIT_128(ORIENTATION_TX_CHARACTERISTIC_UUID);
 struct bt_uuid_128 bt_uuid_ppg_quality = BT_UUID_INIT_128(PPG_QUALITY_CHARACTERISTIC_UUID);
 struct bt_uuid_128 bt_uuid_acc_quality = BT_UUID_INIT_128(ACC_QUALITY_CHARACTERISTIC_UUID);
#define BT_UUID_TFMICRO_SERVICE      (struct bt_uuid *)(&bt_uuid_tfmicro)
#define BT_UUID_TFMICRO_CONFIG_RX   (struct bt_uuid *)(&bt_uuid_config_rx)
#define BT_UUID_TFMICRO_TX   (struct bt_uuid *)(&bt_uuid_tfmicro_tx)
#define BT_UUID_PPG_TX   (struct bt_uuid *)(&bt_uuid_ppg_tx)
#define BT_UUID_ACC_GYRO_TX   (struct bt_uuid *)(&bt_uuid_acc_gyro_tx)
#define BT_UUID_MAGNETO_TX   (struct bt_uuid *)(&bt_uuid_magneto_tx)
#define BT_UUID_ORIENTATION_TX   (struct bt_uuid *)(&bt_uuid_orientation_tx)
#define BT_UUID_PPG_QUALITY   (struct bt_uuid *)(&bt_uuid_ppg_quality)
#define BT_UUID_ACC_QUALITY   (struct bt_uuid *)(&bt_uuid_acc_quality)

uint16_t sampleFreq=25;
#define MAX_TRANSMIT_SIZE 250//TODO figure this out

uint8_t data_rx[MAX_TRANSMIT_SIZE];
uint8_t data_tx[MAX_TRANSMIT_SIZE];
struct tfMicro_configData tfMicroCoonfig;
int tfMicro_service_init(void){
  int err=0;

  memset(&data_rx, 0,MAX_TRANSMIT_SIZE);
  memset(&data_tx, 0,MAX_TRANSMIT_SIZE);
  return err;
}

/* This function is called whenever the RX Characteristic has been written to by a Client */
ssize_t on_receive(struct bt_conn *conn,
			  const struct bt_gatt_attr *attr,
			  const void *buf,
			  uint16_t len,
			  uint16_t offset,
			  uint8_t flags){
  const uint8_t * buffer =(const uint8_t*) buf;
  
  printk("Received data, handle %d, conn %p, data: 0x", attr->handle, conn);
  for(uint8_t i = 0; i < len; i++){
        printk("%02X,", buffer[i]);
  }
  printk("\n");

  switch(buffer[0]){
    case BLE_CONFIG_SENSOR_ENABLE:
      // Enabling or disabling sensors
      if((buffer[1] & IMU_ENABLE) == IMU_ENABLE){
        gyroConfig.isEnabled = true;
        accelConfig.isEnabled = true;
        configRead[1] = configRead[1] | 0x02;
      }
      else if((buffer[1] & IMU_ENABLE) == 0x00){
        gyroConfig.isEnabled = false;
        accelConfig.isEnabled = false;
        configRead[1] = configRead[1] & 0xFD;     
      }
      if((buffer[1] & MAGNETOMETER_ENABLE) == MAGNETOMETER_ENABLE){
        magnetoConfig.isEnabled = true;
        configRead[1] = configRead[1] | 0x10; 
      }
      else if((buffer[1] & MAGNETOMETER_ENABLE) == 0x00){
        magnetoConfig.isEnabled = false;
        configRead[1] = configRead[1] & 0xEF;        
      }
      if((buffer[1] & PPG_ENABLE) == PPG_ENABLE){
        ppgConfig.isEnabled = true;
        configRead[1] = configRead[1] | 0x01; 
      }
      else if((buffer[1] & PPG_ENABLE) == 0x00){
        ppgConfig.isEnabled = false;
        configRead[1] = configRead[1] & 0xFE; 
      }     
      if((buffer[1] & ORIENTATION_ENABLE) == ORIENTATION_ENABLE){
        orientationConfig.isEnabled = true;
        configRead[1] = configRead[1] | 0x04; 
      }
      else if((buffer[1] & ORIENTATION_ENABLE) == 0x00){
        orientationConfig.isEnabled = false;
        configRead[1] = configRead[1] & 0xFB; 
      }
      if((buffer[2] & MOTION_BLE_ENABLE) == MOTION_BLE_ENABLE){
        accelConfig.txPacketEnable = true;
        gyroConfig.txPacketEnable = true;
        configRead[0] = configRead[0] | 0x02;
      }
      else if((buffer[2] & MOTION_BLE_ENABLE) == MOTION_BLE_ENABLE){
        accelConfig.txPacketEnable = false;
        gyroConfig.txPacketEnable = false;
        configRead[0] = configRead[0] & 0xFD;     
      }
      if((buffer[2] & MAGNETOMETER_BLE_ENABLE) == MAGNETOMETER_BLE_ENABLE){
        magnetoConfig.txPacketEnable = true;
        configRead[0] = configRead[0] | 0x10; 
      }
      else if((buffer[2] & MAGNETOMETER_BLE_ENABLE) == 0x00){
        magnetoConfig.txPacketEnable = false;
        configRead[0] = configRead[0] & 0xEF; 
      }
      if((buffer[2] & PPG_BLE_ENABLE) == PPG_BLE_ENABLE){
        ppgConfig.txPacketEnable = true;
        configRead[0] = configRead[0] | 0x01; 
      }
      else if((buffer[2] & PPG_BLE_ENABLE) == 0x00){
        ppgConfig.txPacketEnable = false;
        configRead[0] = configRead[0] & 0xFE; 
      }
      if((buffer[2] & ORIENTATION_BLE_ENABLE) == ORIENTATION_BLE_ENABLE){
        orientationConfig.txPacketEnable = true;
        configRead[0] = configRead[0] | 0x04; 
      }
      else if((buffer[2] & ORIENTATION_BLE_ENABLE) == 0x00){
        orientationConfig.txPacketEnable = false;
        configRead[0] = configRead[0] & 0xFB; 
      }
      if((buffer[2] & TFMICRO_BLE_ENABLE) == TFMICRO_BLE_ENABLE){
        tfMicroCoonfig.txPacketEnable = true;
        configRead[0] = configRead[0] | 0x08; 
      }
      else if((buffer[2] & TFMICRO_BLE_ENABLE) == 0x00){
        tfMicroCoonfig.txPacketEnable = false;
        configRead[0] = configRead[0] & 0xF7; 
      }
      break;
    case BLE_CONFIG_GYRO_SENSITIVITY:
      // configuring Gyroscope Full-scale
      if(buffer[1] == GYRO_250_DPS){
        gyroConfig.sensitivity = GYRO_FS_SEL_250;
        configRead[4] = 0x10 | (configRead[4]&0x0F);
      }
      else if(buffer[1] == GYRO_500_DPS){
        gyroConfig.sensitivity = GYRO_FS_SEL_500;
        configRead[4] = 0x20 | (configRead[4]&0x0F);
      }
      else if(buffer[1] == GYRO_1000_DPS){
        gyroConfig.sensitivity = GYRO_FS_SEL_1000;
        configRead[4] = 0x30 | (configRead[4]&0x0F);
      }
      else if(buffer[1] == GYRO_2000_DPS){
        gyroConfig.sensitivity = GYRO_FS_SEL_2000;
        configRead[4] = 0x40 | (configRead[4]&0x0F);
      }
      else{
        gyroConfig.sensitivity = GYRO_FS_SEL_500;
        configRead[4] = 0x10 | (configRead[4]&0x0F);
      }
      motionSensitivitySampling_config();
      break;
    case BLE_CONFIG_ACC_SENSITIVITY:
      // configuring Accelerometer Full-scale
      if(buffer[1] == ACC_2G){
        accelConfig.sensitivity = ACCEL_FS_SEL_2g;
        configRead[4] = 0x01 | (configRead[4]&0xF0);
      }
      else if(buffer[1] == ACC_4G){
        accelConfig.sensitivity = ACCEL_FS_SEL_4g;
        configRead[4] = 0x02 | (configRead[4]&0xF0);
      }
      else if(buffer[1] == ACC_8G){
        accelConfig.sensitivity = ACCEL_FS_SEL_8g;
        configRead[4] = 0x03 | (configRead[4]&0xF0);
      }
      else if(buffer[1] == ACC_16G){
        accelConfig.sensitivity = ACCEL_FS_SEL_16g;
        configRead[4] = 0x04 | (configRead[4]&0xF0);
      }
      else{
        accelConfig.sensitivity = ACCEL_FS_SEL_4g;
        configRead[4] = 0x01 | (configRead[4]&0xF0);
      }
      motionSensitivitySampling_config();
      break;
    case BLE_CONFIG_LED_INTENSITY_GREEN:
      // configuring PPG Green intensity
      ppgConfig.green_intensity = buffer[1];
      configRead[2] = ppgConfig.green_intensity;
      ppg_changeIntensity();
      break;
    case BLE_CONFIG_LED_INTENSITY_IR:
      // configuring PPG IR intensity
      ppgConfig.infraRed_intensity = buffer[1];
      configRead[3] = ppgConfig.infraRed_intensity;
      ppg_changeIntensity();
      break;
    case BLE_CONFIG_SAMPLING_RATE_ACC:
      // configuring Gyroscope sampling-rate
      if(buffer[1] == MOTION_25_FS){
        accelConfig.sample_bw = ACCEL_DLPFCFG_12HZ;
        gyroConfig.tot_samples = 8;
        configRead[5] = 0x04 | (configRead[5]&0xF0);
      }
      else if(buffer[1] == MOTION_50_FS){
        accelConfig.sample_bw = ACCEL_DLPFCFG_24HZ;
        gyroConfig.tot_samples = 4;
        configRead[5] = 0x03 | (configRead[5]&0xF0);
      }
      else if(buffer[1] == MOTION_100_FS){
        accelConfig.sample_bw = ACCEL_DLPFCFG_50HZ;
        gyroConfig.tot_samples = 2;
        configRead[5] = 0x02 | (configRead[5]&0xF0);
      }
      else if(buffer[1] == MOTION_200_FS){
        accelConfig.sample_bw = ACCEL_DLPFCFG_50HZ;
        gyroConfig.tot_samples = 1;
        configRead[5] = 0x01 | (configRead[5]&0xF0);
      }
      else{
        accelConfig.sample_bw = ACCEL_DLPFCFG_12HZ;
        gyroConfig.tot_samples = 8;
        configRead[5] = 0x04 | (configRead[5]&0xF0);
      }
      motionSensitivitySampling_config();
      break;
    case BLE_CONFIG_SAMPLING_RATE_PPG:
      // configuring PPG sampling-rate
      if(buffer[1] == PPG_25_FS){ 
        ppgConfig.sample_avg = PPG_SMP_AVE_16;
        ppgConfig.numCounts = 8;
        configRead[5] = 0x40 | (configRead[5]&0x0F);
        timeWindow = 50;
        high_pass_filter_init_25();
      }
      else if(buffer[1] == PPG_50_FS){
        ppgConfig.sample_avg = PPG_SMP_AVE_8;
        ppgConfig.numCounts = 4;
        configRead[5] = 0x30 | (configRead[5]&0x0F);
        timeWindow = 100;
        high_pass_filter_init_50();
      }
      else if(buffer[1] == PPG_100_FS){
        ppgConfig.sample_avg = PPG_SMP_AVE_4;
        ppgConfig.numCounts = 2;
        configRead[5] = 0x20 | (configRead[5]&0x0F);
        timeWindow = 200;
        high_pass_filter_init_100();
      }
      else if(buffer[1] == PPG_200_FS){
        ppgConfig.sample_avg = PPG_SMP_AVE_2;
        ppgConfig.numCounts = 1;
        configRead[5] = 0x10 | (configRead[5]&0x0F);
        timeWindow = 400;
        high_pass_filter_init_200();
      }
      else{
        ppgConfig.sample_avg = PPG_SMP_AVE_16;
        ppgConfig.numCounts = 8;
        high_pass_filter_init_25();
        timeWindow = 50;
        configRead[5] = 0x40 | (configRead[5]&0x0F);
      }
      ppg_changeSamplingRate();
      break;
    default: 
      printk("Error, CCCD has been set to an invalid value");        
  }
  return len;
}

/* This function is called whenever a Notification has been sent by the TX Characteristic */
static void on_sent(struct bt_conn *conn, void *user_data){
  ARG_UNUSED(user_data);
  const bt_addr_le_t * addr = bt_conn_get_dst(conn);
    /*    
	//printk("Data sent to Address 0x %02X %02X %02X %02X %02X %02X \n", addr->a.val[0]
                                                                    , addr->a.val[1]
                                                                    , addr->a.val[2]
                                                                    , addr->a.val[3]
                                                                    , addr->a.val[4]
                                                                    , addr->a.val[5]);*/
}

/* This function is called whenever the CCCD register has been changed by the client*/
void on_cccd_changed(const struct bt_gatt_attr *attr, uint16_t value){
  
  ARG_UNUSED(attr);
  switch(value){
    case BT_GATT_CCC_NOTIFY: 
      // Start sending stuff!
      break;
    case BT_GATT_CCC_INDICATE: 
      // Start sending stuff via indications
      break;

    case 0: 
      // Stop sending stuff
      break;
        
    default: 
      printk("Error, CCCD has been set to an invalid value");     
  }
}
                        

/* TF micro Button Service Declaration and Registration */
BT_GATT_SERVICE_DEFINE(tfMicro_service,
  BT_GATT_PRIMARY_SERVICE(BT_UUID_TFMICRO_SERVICE), //0
  /*BT_GATT_CHARACTERISTIC(BT_UUID_TFMICRO_CONFIG_RX, //1,2
    BT_GATT_CHRC_READ | BT_GATT_CHRC_WRITE | BT_GATT_CHRC_WRITE_WITHOUT_RESP,
    BT_GATT_PERM_READ | BT_GATT_PERM_WRITE, 
    configSet, on_receive, configRead),
  BT_GATT_CUD(CONFIG_NAME, BT_GATT_PERM_READ),//3
  BT_GATT_CHARACTERISTIC(BT_UUID_TFMICRO_TX, //4,5
    BT_GATT_CHRC_NOTIFY, BT_GATT_PERM_READ,
    NULL, NULL, NULL),
  BT_GATT_CCC(on_cccd_changed, //6
    BT_GATT_PERM_READ | BT_GATT_PERM_WRITE), 
  BT_GATT_CUD(TFMICRO_NAME, BT_GATT_PERM_READ),*///7
  BT_GATT_CHARACTERISTIC(BT_UUID_PPG_TX,//8,9
    BT_GATT_CHRC_NOTIFY,BT_GATT_PERM_READ,
    NULL, NULL, NULL),
  BT_GATT_CCC(on_cccd_changed, //10
    BT_GATT_PERM_READ | BT_GATT_PERM_WRITE),
  BT_GATT_DESCRIPTOR(BT_UUID_PPG_QUALITY,//11
    BT_GATT_PERM_READ, read_ppg_quality,
    NULL, ppgQuality),
  BT_GATT_CUD(PPG_NAME, BT_GATT_PERM_READ),//12
  BT_GATT_CHARACTERISTIC(BT_UUID_ACC_GYRO_TX,//13,14
    BT_GATT_CHRC_NOTIFY,BT_GATT_PERM_READ,
    NULL, NULL, NULL),
  BT_GATT_CCC(on_cccd_changed, //15
        BT_GATT_PERM_READ | BT_GATT_PERM_WRITE),
  BT_GATT_DESCRIPTOR(BT_UUID_ACC_QUALITY,//16
    BT_GATT_PERM_READ, read_acc_quality,
    NULL, accQuality),
  BT_GATT_CUD(ACC_NAME, BT_GATT_PERM_READ),//17
  BT_GATT_CHARACTERISTIC(BT_UUID_MAGNETO_TX,//18,19
    BT_GATT_CHRC_NOTIFY,BT_GATT_PERM_READ,
    NULL, NULL, NULL),
  BT_GATT_CCC(on_cccd_changed, //20
        BT_GATT_PERM_READ | BT_GATT_PERM_WRITE),
  BT_GATT_CUD(MAGNETO_NAME, BT_GATT_PERM_READ),//21
  BT_GATT_CHARACTERISTIC(BT_UUID_ORIENTATION_TX,//22,23
    BT_GATT_CHRC_NOTIFY,BT_GATT_PERM_READ,
    NULL, NULL, NULL),
BT_GATT_CCC(on_cccd_changed, //24
        BT_GATT_PERM_READ | BT_GATT_PERM_WRITE),
BT_GATT_CUD(ORIENTATION_NAME, BT_GATT_PERM_READ)//25
);


/* This function sends a notification to a Client with the provided data,
given that the Client Characteristic Control Descripter has been set to Notify (0x1).
It also calls the on_sent() callback if successful*/

  /* 
    The attribute for the TX characteristic is used with bt_gatt_is_subscribed 
    to check whether notification has been enabled by the peer or not.
    Attribute table: 0 = Service, 1 = Primary service, 2 = RX, 3 = TX, 4 = CCC,.
  */

void tfMicro_service_send(struct bt_conn *conn, const uint8_t *data, uint16_t len){
  const struct bt_gatt_attr *attr = &tfMicro_service.attrs[BLE_ATTR_TFMICRO_CHARACTERISTIC]; 
  struct bt_gatt_notify_params params = {
    .uuid   = BT_UUID_TFMICRO_TX,
    .attr   = attr,
    .data   = data,
    .len    = len,
    .func   = on_sent
  };
    
  // Check whether notifications are enabled or not
  if(bt_gatt_is_subscribed(conn, attr, BT_GATT_CCC_NOTIFY)) {
    // Send the notification
    if(bt_gatt_notify_cb(conn, &params)){
            printk("Error, unable to send notification\n");
    }
  }
  else{
      //  printk("Warning, notification not enabled on the selected attribute\n");
  }
}

/* This function sends a notification to a Client with the provided data,
given that the Client Characteristic Control Descripter has been set to Notify (0x1).
It also calls the on_sent() callback if successful*/
void ppg_send(struct bt_conn *conn, const uint8_t *data, uint16_t len){
  const struct bt_gatt_attr *attr = &tfMicro_service.attrs[BLE_ATTR_PPG_CHARACTERISTIC]; 
  struct bt_gatt_notify_params params = {
    .uuid   = BT_UUID_PPG_TX,
    .attr   = attr,
    .data   = data,
    .len    = len,
    .func   = on_sent
  };
    
  // Check whether notifications are enabled or not
  if(bt_gatt_is_subscribed(conn, attr, BT_GATT_CCC_NOTIFY)) {
    // Send the notification
    if(bt_gatt_notify_cb(conn, &params)){
            //printk("Error, unable to send notification\n");
    }
  }
  else{
        //printk("Warning, notification not enabled on the selected attribute\n");
  }
}

void acc_send(struct bt_conn *conn, const uint8_t *data, uint16_t len){
  const struct bt_gatt_attr *attr = &tfMicro_service.attrs[BLE_ATTR_ACC_CHARACTERISTIC]; 
  struct bt_gatt_notify_params params = {
    .uuid   = BT_UUID_ACC_GYRO_TX,
    .attr   = attr,
    .data   = data,
    .len    = len,
    .func   = on_sent
  };

    //printk("attr Counts = %d,selected = %d,handle=%d\n",tfMicro_service.attr_count,BLE_ATTR_ACC_CHARACTERISTIC,attr->handle);
    
  // Check whether notifications are enabled or not

  if(bt_gatt_is_subscribed(conn, attr, BT_GATT_CCC_NOTIFY)) {
    // Send the notification
    
    if(bt_gatt_notify_cb(conn, &params)){
            printk("Error, unable to send notification\n");
    }
    
  }
  else{
      //  printk("Warning, notification not enabled on the selected attribute\n");
  }

}
void magnetometer_send(struct bt_conn *conn, const uint8_t *data, uint16_t len){
  const struct bt_gatt_attr *attr = &tfMicro_service.attrs[BLE_ATTR_MAGNETO_CHARACTERISTIC]; 
  struct bt_gatt_notify_params params = {
    .uuid   = BT_UUID_MAGNETO_TX,
    .attr   = attr,
    .data   = data,
    .len    = len,
    .func   = on_sent
  };
    
  // Check whether notifications are enabled or not
  if(bt_gatt_is_subscribed(conn, attr, BT_GATT_CCC_NOTIFY)) {
    // Send the notification
    if(bt_gatt_notify_cb(conn, &params)){
            //printk("Error, unable to send notification\n");
    }
  }
  else{
        //printk("Warning, notification not enabled on the selected attribute\n");
  }
}

void orientation_send(struct bt_conn *conn, const uint8_t *data, uint16_t len){
  const struct bt_gatt_attr *attr = &tfMicro_service.attrs[BLE_ATTR_ORIENTATION_CHARACTERISTIC]; 
  struct bt_gatt_notify_params params = {
    .uuid   = BT_UUID_ORIENTATION_TX,
    .attr   = attr,
    .data   = data,
    .len    = len,
    .func   = on_sent
  };
    
  // Check whether notifications are enabled or not
  if(bt_gatt_is_subscribed(conn, attr, BT_GATT_CCC_NOTIFY)) {
    // Send the notification
    if(bt_gatt_notify_cb(conn, &params)){
            //printk("Error, unable to send notification\n");
    }
  }
  else{
        //printk("Warning, notification not enabled on the selected attribute\n");
  }
}
void tfMicro_notify(struct k_work *item){
  struct TfMicroInfo* the_device =  ((struct TfMicroInfo *)(((char *)(item)) - offsetof(struct TfMicroInfo, work)));
  
  uint8_t *dataPacket = the_device->dataPacket;
  uint8_t packetLength = the_device->packetLength;

  ////printk("data LED =%u, Data counter1=%u, Data counter2=%u,pk=%u\n", dataPacket[0],dataPacket[1],dataPacket[2],packetLength);
  tfMicro_service_send(my_connection, the_device->dataPacket, TFMICRO_DATA_LEN);
}
void motion_notify(struct k_work *item){
  struct motionSendInfo* the_device=  ((struct motionSendInfo *)(((char *)(item)) - offsetof(struct motionSendInfo, work)));
  
  uint8_t *dataPacket = the_device->dataPacket;
  uint8_t packetLength = the_device->packetLength;

  ////printk("data LED =%u, Data counter1=%u, Data counter2=%u,pk=%u\n", dataPacket[0],dataPacket[1],dataPacket[2],packetLength);
  acc_send(my_connection, the_device->dataPacket, ACC_GYRO_DATA_LEN);
}
void magneto_notify(struct k_work *item){
  struct magnetoInfo* the_device=  ((struct magnetoInfo *)(((char *)(item)) - offsetof(struct magnetoInfo, work)));
  
  uint8_t *dataPacket = the_device->dataPacket;
  uint8_t packetLength = the_device->packetLength;

  ////printk("data LED =%u, Data counter1=%u, Data counter2=%u,pk=%u\n", dataPacket[0],dataPacket[1],dataPacket[2],packetLength);
  magnetometer_send(my_connection, the_device->dataPacket, MAGNETOMETER_DATA_LEN);
}
void orientation_notify(struct k_work *item){
  struct orientationInfo* the_device=  ((struct orientationInfo *)(((char *)(item)) - offsetof(struct orientationInfo, work)));
  
  uint8_t *dataPacket = the_device->dataPacket;
  uint8_t packetLength = the_device->packetLength;

  ////printk("data LED =%u, Data counter1=%u, Data counter2=%u,pk=%u\n", dataPacket[0],dataPacket[1],dataPacket[2],packetLength);
  orientation_send(my_connection, the_device->dataPacket, ORIENTATION_DATA_LEN);
}
void ppgData_notify(struct k_work *item){
  struct ppgDataInfo* the_device=  ((struct ppgDataInfo *)(((char *)(item)) - offsetof(struct ppgDataInfo, work)));
  
  uint8_t *dataPacket = the_device->dataPacket;
  uint8_t packetLength = the_device->packetLength;

  ////printk("data LED =%u, Data counter1=%u, Data counter2=%u,pk=%u\n", dataPacket[0],dataPacket[1],dataPacket[2],packetLength);
  ppg_send(my_connection, the_device->dataPacket, PPG_DATA_UNFILTER_LEN);
}

static ssize_t configSet(struct bt_conn *conn,const struct bt_gatt_attr *attr, void *buf,
  uint16_t len, uint16_t offset){
  uint8_t *value1 = (uint8_t *)attr->user_data;
  uint8_t *rsp;

  rsp = value1;
  return bt_gatt_attr_read(conn, attr, buf, len, offset, rsp,CONFIG_RX_DATA_LEN);
}
static ssize_t read_ppg_quality(struct bt_conn *conn,const struct bt_gatt_attr *attr, void *buf,
  uint16_t len, uint16_t offset){
  uint8_t *value1 = (uint8_t *)attr->user_data;
  uint8_t *rsp;

  rsp = value1;

  return bt_gatt_attr_read(conn, attr, buf, len, offset, rsp,PPGQUALITY_DATA_LEN);
}
static ssize_t read_acc_quality(struct bt_conn *conn,const struct bt_gatt_attr *attr, void *buf,
  uint16_t len, uint16_t offset){
  uint8_t *value1 = (uint8_t *)attr->user_data;
  uint8_t *rsp;

  rsp = value1;

  return bt_gatt_attr_read(conn, attr, buf, len, offset, rsp,ACCQUALITY_DATA_LEN);
}
```

## src/BLEService.h
```c
#ifndef BLESERVICE_H_
#define BLESERVICE_H_
#include <zephyr/types.h>
#include <stddef.h>
#include <string.h>
#include <errno.h>
#include <zephyr.h>
#include <soc.h>
#include "common.h"
#include <bluetooth/bluetooth.h>
#include <bluetooth/hci.h>
#include <bluetooth/conn.h>
#include <bluetooth/uuid.h>
#include <bluetooth/gatt.h>

#define TFMICRO_DATA_LEN 66
#define PPG_DATA_LEN 18
#define PPG_DATA_UNFILTER_LEN 12
#define ACC_GYRO_DATA_LEN 20
#define MAGNETOMETER_DATA_LEN 8
#define ORIENTATION_DATA_LEN 18
#define CONFIG_RX_DATA_LEN 6
#define PPGQUALITY_DATA_LEN 4
#define ACCQUALITY_DATA_LEN 4

#define BLE_ATTR_PRIMARY_SERVICE 0
#define BLE_ATTR_CONFIG_CHARACTERISTIC 1
#define BLE_ATTR_TFMICRO_CHARACTERISTIC 4
#define BLE_ATTR_PPG_CHARACTERISTIC 8
#define BLE_ATTR_ACC_CHARACTERISTIC 13
#define BLE_ATTR_MAGNETO_CHARACTERISTIC 18
#define BLE_ATTR_ORIENTATION_CHARACTERISTIC 22


// BLE CONFIG COMMAND
#define BLE_CONFIG_SENSOR_ENABLE 0x00
#define BLE_CONFIG_GYRO_SENSITIVITY 0x01
#define BLE_CONFIG_ACC_SENSITIVITY 0x02
#define BLE_CONFIG_LED_INTENSITY_GREEN 0x03
#define BLE_CONFIG_LED_INTENSITY_IR 0x04
#define BLE_CONFIG_SAMPLING_RATE_ACC 0x05
#define BLE_CONFIG_SAMPLING_RATE_PPG 0x06

// BLE CONFIG DATA
#define IMU_ENABLE 0x02
#define MOTION_BLE_ENABLE 0x02
#define MAGNETOMETER_ENABLE 0x10
#define MAGNETOMETER_BLE_ENABLE 0x10
#define PPG_ENABLE 0x01
#define PPG_BLE_ENABLE 0x01
#define ORIENTATION_ENABLE 0x04
#define ORIENTATION_BLE_ENABLE 0x04
#define TFMICRO_ENABLE 0x08
#define TFMICRO_BLE_ENABLE 0x08
#define GYRO_250_DPS 0x00
#define GYRO_500_DPS 0x01
#define GYRO_1000_DPS 0x02
#define GYRO_2000_DPS 0x03
#define ACC_2G 0x00
#define ACC_4G 0x01
#define ACC_8G 0x02
#define ACC_16G 0x03
#define MOTION_200_FS 0x00
#define MOTION_100_FS 0x01
#define MOTION_50_FS 0x02
#define MOTION_25_FS 0x03
#define PPG_200_FS 0x01
#define PPG_100_FS 0x02
#define PPG_50_FS 0x03
#define PPG_25_FS 0x04

// Main Service UUID 
#define TFMICRO_SERVICE_UUID 0x1F, 0x35, 0xBD, 0x4B, 0xAE, 0xD0, 0x68, 0x9C,\
  0xE2, 0x48, 0x81, 0x1D, 0x22, 0x5D, 0x39, 0xDA      

// Configuration characteristic UUID
#define RX_CHARACTERISTIC_UUID  0x1F, 0x35, 0xBD, 0x4B, 0xAE, 0xD0, 0x68, 0x9C, \
  0xE2, 0x48, 0x81, 0x1D, 0x21, 0xC9, 0x39, 0xDA       

// TF micro PPG HR characteristic UUID
#define TF_HR_TX_CHARACTERISTIC_UUID  0x1F, 0x35, 0xBD, 0x4B, 0xAE, 0xD0, 0x68, 0x9C, \
  0xE2, 0x48, 0x81, 0x1D, 0x22, 0xC9, 0x39, 0xDA       
	
// PPG data characteristic UUID
#define PPG_TX_CHARACTERISTIC_UUID  0x1F, 0x35, 0xBD, 0x4B, 0xAE, 0xD0, 0x68, 0x9C, \
  0xE2, 0x48, 0x81, 0x1D, 0x23, 0xC9, 0x39, 0xDA         
                                           
// Acc and Gyro data characteristic UUID
#define ACC_GRYO_TX_CHARACTERISTIC_UUID  0x1F, 0x35, 0xBD, 0x4B, 0xAE, 0xD0, 0x68, 0x9C, \
  0xE2, 0x48, 0x81, 0x1D, 0x24, 0xC9, 0x39, 0xDA   

// Magnetometer data characteristic UUID
#define MAGNETO_TX_CHARACTERISTIC_UUID  0x1F, 0x35, 0xBD, 0x4B, 0xAE, 0xD0, 0x68, 0x9C, \
  0xE2, 0x48, 0x81, 0x1D, 0x25, 0xC9, 0x39, 0xDA   

// Orientation data characteristic UUID
#define ORIENTATION_TX_CHARACTERISTIC_UUID  0x1F, 0x35, 0xBD, 0x4B, 0xAE, 0xD0, 0x68, 0x9C, \
  0xE2, 0x48, 0x81, 0x1D, 0x26, 0xC9, 0x39, 0xDA  
   
// PPG Singal quality descriptor characteristic UUID
#define PPG_QUALITY_CHARACTERISTIC_UUID  0x1F, 0x35, 0xBD, 0x4B, 0xAE, 0xD0, 0x68, 0x9C, \
  0xE2, 0x48, 0x81, 0x1D, 0x27, 0xC9, 0x39, 0xDA   

// Acc Singal quality descriptor characteristic UUID
#define ACC_QUALITY_CHARACTERISTIC_UUID  0x1F, 0x35, 0xBD, 0x4B, 0xAE, 0xD0, 0x68, 0x9C, \
  0xE2, 0x48, 0x81, 0x1D, 0x28, 0xC9, 0x39, 0xDA   

extern uint8_t configRead[6];
extern uint8_t ppgQuality[4];
extern uint8_t accQuality[4];

/** @brief Callback type for when new data is received. */
typedef void (*data_rx_cb_t)(uint8_t *data, uint8_t length);

/** @brief Callback struct used by the tfMicro_service Service. */
struct tfMicro_service_cb {
  /** Data received callback. */
  data_rx_cb_t    data_rx_cb;
};
struct TfMicroInfo {
    struct k_work work;
    uint8_t *dataPacket;
    uint8_t packetLength;
}; 

struct motionSendInfo {
    struct k_work work;
    uint8_t *dataPacket;
    uint8_t packetLength;
}; 
extern struct TfMicroInfo my_HeartRateEncoder;  // work-queue instance for tflite notifications
extern struct motionSendInfo my_motionData;  // work-queue instance for tflite notifications

int tfMicro_service_init(void);

void tfMicro_service_send(struct bt_conn *conn, const uint8_t *data, uint16_t len);
void tfMicro_notify(struct k_work *);
void ppg_send(struct bt_conn *conn, const uint8_t *data, uint16_t len);
void acc_send(struct bt_conn *conn, const uint8_t *data, uint16_t len);
void magnetometer_send(struct bt_conn *conn, const uint8_t *data, uint16_t len);
void orientation_send(struct bt_conn *conn, const uint8_t *data, uint16_t len);
void motion_notify(struct k_work *item);
void magneto_notify(struct k_work *item);
void orientation_notify(struct k_work *item);
void ppgData_notify(struct k_work *item);
static ssize_t configSet(struct bt_conn *,const struct bt_gatt_attr *, void *, uint16_t , uint16_t );
static ssize_t read_ppg_quality(struct bt_conn *,const struct bt_gatt_attr *, void *, uint16_t , uint16_t );
static ssize_t read_acc_quality(struct bt_conn *,const struct bt_gatt_attr *, void *, uint16_t , uint16_t );
 #endif
```

## src/constants.cc
```c
#include "constants.h"

const int kInferencesPerCycle = 10000;
```

## src/output_handler.h
```c
void HandleOutput(const char* string);

void InitOutput();
```
